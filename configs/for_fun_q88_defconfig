## configs/for_fun_q88_defconfig
```kconfig
CONFIG_ARM=y
CONFIG_ARCH_SUNXI=y
CONFIG_SPL=y
CONFIG_MACH_SUN5I=y
CONFIG_DRAM_CLK=384
CONFIG_MMC0_CD_PIN="PG0"
CONFIG_USB0_VBUS_PIN="PG12"
CONFIG_USB0_VBUS_DET="PG1"
CONFIG_USB0_ID_DET="PG2"
CONFIG_AXP_GPIO=y
CONFIG_AXP_ALDO3_VOLT=3300
CONFIG_AXP_ALDO3_INRUSH_QUIRK=y
# CONFIG_VIDEO_HDMI is not set
CONFIG_DEFAULT_DEVICE_TREE="sun5i-a13-for-fun-q88"
CONFIG_NAND_BOOT=y
CONFIG_SD_BOOT=y
# CONFIG_USE_BOOTCOMMAND is not set
CONFIG_SPL_I2C_SUPPORT=y
# CONFIG_ENV_IS_IN_FAT is not set
CONFIG_ENV_IS_IN_NAND=y
CONFIG_ENV_OFFSET=0x200000
# CONFIG_NET is not set
CONFIG_SYS_NAND_BLOCK_SIZE=0x200000
CONFIG_SYS_NAND_PAGE_SIZE=0x2000
CONFIG_SYS_NAND_OOBSIZE=448
CONFIG_CONS_INDEX=2
CONFIG_USB_MUSB_HOST=y
CONFIG_MTD=y
CONFIG_MTD_DEVICE=y
CONFIG_MTD_PARTITIONS=y
CONFIG_CMD_MTDPARTS=y
CONFIG_CMD_MTD=y
CONFIG_DM_MTD=y
```

## configs/inet_3ftd_defconfig
```kconfig
CONFIG_ARM=y
CONFIG_ARCH_SUNXI=y
CONFIG_SPL=y
CONFIG_MACH_SUN4I=y
CONFIG_DRAM_CLK=480
CONFIG_MMC0_CD_PIN="PH1"
CONFIG_USB0_ID_DET="PH4"
CONFIG_USB0_VBUS_DET="PH5"
CONFIG_USB0_VBUS_PIN="PH9"
CONFIG_AXP_GPIO=y
CONFIG_SATAPWR="PB8"
CONFIG_DEFAULT_DEVICE_TREE="sun4i-a10-inet-3ftd"
CONFIG_SPL_I2C_SUPPORT=y
CONFIG_SD_BOOT=y
CONFIG_NAND=y
CONFIG_NAND_BOOT=y
CONFIG_SYS_NAND_BLOCK_SIZE=0x200000
CONFIG_SYS_NAND_PAGE_SIZE=0x2000
CONFIG_SYS_NAND_OOBSIZE=448
CONFIG_CONS_INDEX=1
CONFIG_USB_MUSB_HOST=y
CONFIG_MTD=y
CONFIG_MTD_DEVICE=y
CONFIG_MTD_PARTITIONS=y
# CONFIG_MTD_RAW_NAND=y
CONFIG_CMD_MTDPARTS=y
CONFIG_CMD_MTD=y
CONFIG_DM_MTD=y
CONFIG_ENV_IS_IN_NAND=y
CONFIG_ENV_OFFSET=0x200000
CONFIG_VIDEO_LCD_MODE="x:1024,y:600,depth:18,pclk_khz:45000,le:150,ri:16,up:21,lo:2,hs:10,vs:2,sync:3,vmode:0"
CONFIG_VIDEO_LCD_POWER="PH8"
CONFIG_VIDEO_LCD_BL_EN="PH7"
CONFIG_VIDEO_LCD_BL_PWM="PB2"
```
